## Kconfig
```kconfig
mainmenu "RT-Thread Configuration"

config $W60X_DIR
    string
    option env="W60X_ROOT"

config $BSP_DIR
    string
    option env="BSP_ROOT"
    default "."

config $RTT_DIR
    string
    option env="RTT_ROOT"
    
# you can change the RTT_ROOT default "../.." to your rtthread_root,
# example : default "F:/git_repositories/rt-thread"

config $PKGS_DIR
    string
    option env="PKGS_ROOT"
    default "packages"
    
config $ENV_DIR
    string
    option env="ENV_ROOT"
    default "/"

menu "Lwip mdns configure"
    config LWIP_MDNS_RESPONDER
        int "Enable lwip mDNS"
        default 1

    config LWIP_NUM_NETIF_CLIENT_DATA
        int "MDNS needs one entry on netif"
        default 1
endmenu

source "$W60X_DIR/rt-thread/Kconfig"
source "$PKGS_DIR/Kconfig"
source "$W60X_DIR/drivers/Kconfig"
source "$W60X_DIR/libraries/Kconfig"
```
